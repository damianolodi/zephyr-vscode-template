## boards/nrf52840dk_nrf52840_debug.conf
```kconfig
# compiler
CONFIG_DEBUG_OPTIMIZATIONS=y
CONFIG_ASSERT=y

# logging
CONFIG_SERIAL=y
CONFIG_CONSOLE=y
CONFIG_UART_CONSOLE=y
CONFIG_LOG=y
CONFIG_LOG_MODE_DEFERRED=y
```

## boards/thingy52_nrf52832_debug.conf
```kconfig
# compiler
CONFIG_DEBUG_OPTIMIZATIONS=y
CONFIG_ASSERT=y

# logging
# See https://docs.zephyrproject.org/latest/develop/flash_debug/nordic_segger.html to know how to read log
CONFIG_CONSOLE=y
CONFIG_UART_CONSOLE=n
CONFIG_RTT_CONSOLE=y
CONFIG_USE_SEGGER_RTT=y
CONFIG_LOG=y
CONFIG_LOG_MODE_DEFERRED=y
```

## west.yml
```yaml
manifest:
  self:
    path: app
    west-commands: scripts/west-commands.yml
  remotes:
    - name: zephyrproject-rtos
      url-base: https://github.com/zephyrproject-rtos
  projects:
    - name: zephyr
      remote: zephyrproject-rtos
      revision: v3.7.0
      import: true
############################################################################################
# Uncomment and remove previous `remotes` and `projects` to configure the project with ncs #
############################################################################################
# remotes:
#   - name: ncs
#     url-base: https://github.com/nrfconnect
# projects:
#   - name: nrf
#     remote: ncs
#     repo-path: sdk-nrf
#     revision: v2.3.0
#     import: true
```
